## app/Kconfig.sysbuild
```kconfig
#
# Copyright (c) 2025 Nordic Semiconductor ASA
#
# SPDX-License-Identifier: LicenseRef-Nordic-5-Clause
#

choice BOOTLOADER
	default BOOTLOADER_MCUBOOT if !BOARD_NATIVE_SIM
endchoice

# Disabled for nrf9151dk (2026-07-05): b0/NSIB writes its public-key-hash
# provisioning data into UICR (0x00FF8000 region). UICR is one-time
# programmable -- once written, EVERY subsequent flash via the safe erase
# mode (chip_erase_mode=ERASE_RANGES_TOUCHED_BY_FIRMWARE) permanently
# demands ERASE_ALL, which is forbidden near nuSIM-provisioned devices (their
# SIM credentials live in a separate but adjacent region of the same UICR
# page). Confirmed on real hardware: the first flash succeeds (blank UICR),
# every flash after that fails without ERASE_ALL. No existing nrf9151dk
# fleet depends on this yet, so it's disabled outright rather than only for
# nuSIM builds (sysbuild Kconfig has no reliable way to know "this build
# uses nuSIM" -- that's decided later, in the app image's own Kconfig).
config SECURE_BOOT_APPCORE
	default n if BOARD_NRF9151DK_NRF9151_NS

config WIFI_NRF70
	default y if BOARD_THINGY91X_NRF9151_NS

choice WIFI_NRF70_OPER_MODES
	default WIFI_NRF70_SCAN_ONLY if BOARD_THINGY91X_NRF9151_NS
endchoice

config PM_EXTERNAL_FLASH_MCUBOOT_SECONDARY
	default y if BOARD_NRF9151DK_NRF9151_NS

source "${ZEPHYR_BASE}/share/sysbuild/Kconfig"
```

## app/boards/circuitdojo_feather_nrf9151_nrf9151_ns.conf
```kconfig
#
# Copyright (c) 2025 Nordic Semiconductor ASA
#
# SPDX-License-Identifier: LicenseRef-Nordic-5-Clause
#

# External flash (w25q128jv on SPI3)
CONFIG_SPI=y
CONFIG_SPI_NOR=y
CONFIG_SPI_NOR_SFDP_RUNTIME=y
CONFIG_PM_OVERRIDE_EXTERNAL_DRIVER_CHECK=y

# Sensor subsystem required for npm1300 charger driver
CONFIG_SENSOR=y

# Power module (npm1300 PMIC)
CONFIG_APP_POWER=y
CONFIG_NRF_FUEL_GAUGE=y
CONFIG_NPM13XX_CHARGER=y

# LED module (via npm1300)
CONFIG_APP_LED=y

# Environmental: Feather has STS4X (temperature only), not BME680.
# APP_ENVIRONMENTAL depends on BME680 so it cannot be enabled here.
# CONFIG_APP_ENVIRONMENTAL is not set

# Location priority order (GNSS first for NTN)
CONFIG_LOCATION_REQUEST_DEFAULT_METHOD_FIRST_GNSS=y
CONFIG_LOCATION_REQUEST_DEFAULT_METHOD_SECOND_CELLULAR=y
```

## app/sysbuild/mcuboot/boards/circuitdojo_feather_nrf9151_nrf9151.conf
```kconfig
#
# Copyright (c) 2025 Nordic Semiconductor ASA
#
# SPDX-License-Identifier: LicenseRef-Nordic-5-Clause
#

# npm1300 MFD driver (enabled unconditionally in defconfig) requires
# kernel work queues, so multithreading must be enabled in mcuboot.
CONFIG_MULTITHREADING=y

CONFIG_BOOT_MAX_IMG_SECTORS=512
```

## app/sysbuild/mcuboot/boards/nrf9151dk_nrf9151.conf
```kconfig
#
# Copyright (c) 2025 Nordic Semiconductor ASA
#
# SPDX-License-Identifier: LicenseRef-Nordic-5-Clause
#

# MCUboot config to enable secondary slot on the external flash

CONFIG_FLASH=y
CONFIG_SPI=y
CONFIG_SPI_NOR=y
CONFIG_SPI_NOR_FLASH_LAYOUT_PAGE_SIZE=4096
CONFIG_SPI_NOR_SFDP_DEVICETREE=y

CONFIG_PM_PARTITION_SIZE_MCUBOOT=0x13E00
CONFIG_PM_OVERRIDE_EXTERNAL_DRIVER_CHECK=y

CONFIG_MULTITHREADING=y
CONFIG_MAIN_STACK_SIZE=2048
CONFIG_BOOT_MAX_IMG_SECTORS=256

# Required by the RedteaMobile nuSIM module (modules/lib/redteamobile-nusim)
# when CONFIG_LIB_NUSIM=y: its sysbuild post_cmake hook hard-fails the build
# otherwise. Placed here (board-specific, all nrf9151dk builds) rather than
# behind -Dmcuboot_EXTRA_CONF_FILE, which did not reliably persist through
# the nRF Connect for VS Code build-configuration UI.
#
# NOTE: this changes the mcuboot signature scheme to ECDSA P256 for EVERY
# nrf9151dk build, not just nuSIM ones. If this board already has RSA-signed
# images in the field expecting FOTA updates, this is a breaking, one-way
# change for that fleet -- confirm that's acceptable before shipping a build
# with this to real devices.
CONFIG_BOOT_FIH_PROFILE_MEDIUM=y
CONFIG_BOOT_SIGNATURE_TYPE_ECDSA_P256=y
CONFIG_BOOT_SIGNATURE_TYPE_RSA=n
CONFIG_MCUBOOT_DOWNGRADE_PREVENTION=y
```

## west.yml
```yaml
# Copyright (c) 2024 Nordic Semiconductor
# SPDX-License-Identifier: LicenseRef-Nordic-5-Clause

manifest:
  self:
    west-commands: scripts/west-commands.yml
    path: project

  remotes:
    - name: ncs
      url-base: https://github.com/nrfconnect
    - name: redteamobile
      url-base: https://github.com/redteamobile

  projects:
    - name: nrf
      remote: ncs
      repo-path: sdk-nrf
      revision: 2d607e644189fd91b80ec5b976d4efc556695350
      import: true
    # RedteaMobile nuSIM support (TF-M secure partition + AT command layer).
    # Pinned to the commit tagged "release: update for NCS v3.2.2", matching
    # the sdk-nrf revision above.
    - name: redteamobile-nusim
      remote: redteamobile
      repo-path: ncs-nusim-app
      path: modules/lib/redteamobile-nusim
      revision: 8a5db8e9cb8907ebf42876b4f9934c462c9f674d
```
